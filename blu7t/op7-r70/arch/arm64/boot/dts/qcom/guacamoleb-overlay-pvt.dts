/* Copyright (c) 2017-2018, The Linux Foundation. All rights reserved.
 *
 * This program is free software; you can redistribute it and/or modify
 * it under the terms of the GNU General Public License version 2 and
 * only version 2 as published by the Free Software Foundation.
 *
 * This program is distributed in the hope that it will be useful,
 * but WITHOUT ANY WARRANTY; without even the implied warranty of
 * MERCHANTABILITY or FITNESS FOR A PARTICULAR PURPOSE.  See the
 * GNU General Public License for more details.
 */

/dts-v1/;
/plugin/;

#include <dt-bindings/clock/qcom,gcc-sm8150.h>
#include <dt-bindings/clock/qcom,camcc-sm8150.h>
#include <dt-bindings/clock/qcom,rpmh.h>
#include <dt-bindings/interrupt-controller/arm-gic.h>

#include "sm8150-mtp.dtsi"
#include "sm8150-mtp-audio-overlay.dtsi"

#include "sm8150-oem.dtsi"
#include "sm8150-oem-camera-guacamoleb.dtsi"
#include "guacamoleb_sm8150.dtsi"
#include "guacamoleb.dtsi"
#include "guacamoleb_pvt.dtsi"

/ {
	model = "MTP 18857 14 15";
	compatible = "qcom,sm8150-mtp", "qcom,sm8150", "qcom,mtp";
	qcom,board-id = <8 0 >;
	/*we can add project id to this array,uefi can auto read it,if new project,we add to this array */
	oem,project-id = <18857>;
	/*we can add hw id to this array,uefi can auto read it,if new hw,we add to this array  */
	oem,hw-id = <14 15>;
};

