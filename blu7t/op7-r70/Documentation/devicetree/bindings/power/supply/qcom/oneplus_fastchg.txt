## blu7t/op7-r70/Documentation/devicetree/bindings/power/supply/qcom/oneplus_fastchg.txt
```
* Fast charge control

Required properties:
 - compatible		      : "microchip,oneplus_fastchg"
 - reg			      : Device address
 - interrupts		      : IRQ specifier


Optional properties:
 - microchip,mcu-en-gpio		  : enable or reset the mcu
 - microchip,usb-sw-1-gpio	      : fast charge switch 1 control
 - microchip,usb-sw-2-gpio	      : fast charge switch 2 control
 - microchip,ap-clk				: gpio work for clk
 - microchip,ap-data			: gpio work for data

Example:

&qupv3_se16_i2c {
	oneplus_fastchg@26{
		status = "ok";
		compatible = "microchip,oneplus_fastchg";
		reg = <0x26>;
		microchip,mcu-en-gpio = <&tlmm 10 0x00>;
		microchip,usb-sw-1-gpio = <&tlmm 50 0x00>;
		microchip,usb-sw-2-gpio = <&tlmm 82 0x00>;
		microchip,ap-clk = <&tlmm 8 0x00>;
		microchip,ap-data = <&tlmm 9 0x00>;

		pinctrl-names = "mux_fastchg_active",
		"mux_fastchg_suspend",
		"mcu_data_active",
		"mcu_data_suspend";
		pinctrl-0 = <&fastchg_active
		&usb_sw_active
		&ap_clk_active>;
		pinctrl-1 = <&usb_sw_suspend
		&fastchg_suspend
		&ap_clk_suspend>;
		pinctrl-2 =<&ap_data_active>;
		pinctrl-3 =<&ap_data_suspend>;
	}
}
```

## blu7t/op7-r70/Documentation/devicetree/bindings/sound/tfa98xx.txt
```
Tfa98xx device

Required Properties
- compatible		Must be "compatible = "nxp,tfa98xx".

Example:


	&qupv3_se4_i2c {
	tfa98xx_right: tfa98xx_right@34 {
			       compatible = "nxp,tfa98xx";
			       reg = <0x34>;
			       reset-gpio = <&tlmm 37 0>;
			       status = "ok";
		       };

	tfa98xx_left: tfa98xx_left@35 {
			      compatible = "nxp,tfa98xx";
			      reg = <0x35>;
			      reset-gpio = <&tlmm 37 0>;
			      status = "ok";
		      };
	};
```

## blu7t/op7-r70/coretech/Kconfig
```kconfig
config OPCHAIN
	default n
	bool "Oneplus CoreTech helper, used for opchain module"
config MEMPLUS
	default n
	bool "memory+ feature"
	help
	 Memory+ feature
config SMART_BOOST
	bool "support smart boost feature"
	default n
	help
	 this feature allow memory used by recent-app stay in kernel.
config DEFRAG
	default n
	bool "anti-defragment feature"
	help
	 anti-defragment feature.
config FSC
	default n
	bool "system layer file status cache"
	help
	 To cache absence file and avoid stat call storm
config HOUSTON
	default n
	bool "to collect system-wide and pmu data"
	help
	 Realtime temperature monitor
config CONTROL_CENTER
	default n
	bool "control center"
config AIGOV
	default n
	bool "A governor which using ai predicted info as input"
```

## blu7t/op7-r70/drivers/input/fingerprint/Kconfig
```kconfig
menuconfig INPUT_FINGERPRINT
	bool "Fingerprint"
	default y
	help
	  Say Y here, and a list of supported fingerprint will be displayed.
	  This option doesn't affect the kernel.

	  If unsure, say Y.

if INPUT_FINGERPRINT

config FINGERPRINT_DETECT
	tristate "fingerprint detect support"
	depends on SPI_MASTER


config FINGERPRINT_GOODIX
	tristate "goodix fingerprint sensor support"
	depends on SPI_MASTER


config MSM_QBT1000
    bool "QBT1000 Ultrasonic Fingerprint Sensor"
    help
      This driver provides services for configuring the fingerprint
      sensor hardware and for communicating with the trusted app which
      uses it. It enables clocks and provides commands for loading
      trusted apps, unloading them and marshalling buffers to the
      trusted fingerprint app.
endif
```

## blu7t/op7-r70/drivers/input/oneplus_touchscreen/Kconfig
```kconfig
config TOUCHPANEL_MTK_PLATFORM
	bool "OP platform tp module used"
	help
	  Say Y here if you have mtk-platform.

config TOUCHPANEL_ONEPLUS
	bool "ONEPLUS tp module"
	help
	  Say Y here if you have touchscreen module.

config TOUCHPANEL_SYNAPTICS
#	default y
	bool "TP Synaptics_IC enable or not for OP"
	---help---
	say Y to enable driver for Touchpanel using Synaptics_IC

config TOUCHPANEL_FOCAL
#	default y
	bool "TP Synaptics_IC enable or not for OP"
	---help---
	say Y to enable driver for Touchpanel using FOCALTECK_IC

config TOUCHPANEL_GOODIX
#	default y
	bool "TP Synaptics_IC enable or not for OP"
	---help---
	say Y to enable driver for Touchpanel using GOODIX_IC

config TOUCHPANEL_NOVA
#	default y
	bool "TP Nova_IC enable or not for OP"
	---help---
	say Y to enable driver for Touchpanel using NOVATECK_IC
config TOUCHPANEL_HIMAX
#	default y
	bool "TP HIMAX_IC enable or not for OP"
	---help---
	say Y to enable driver for Touchpanel using HIMAX_IC

config TOUCHPANEL_SAMSUNG
#	default y
	bool "TP samsung IC enable or not for OP"
	---help---
	say Y to enable driver for Touchpanel using samsung IC

config TOUCHPANEL_ST
#	default y
	bool "TP st IC enable or not for OP"
	---help---
	say Y to enable driver for Touchpanel using st IC

source "drivers/input/oneplus_touchscreen/util_interface/Kconfig"

if TOUCHPANEL_SYNAPTICS
source "drivers/input/oneplus_touchscreen/Synaptics/Kconfig"
endif
if TOUCHPANEL_SAMSUNG
source "drivers/input/oneplus_touchscreen/Samsung/Kconfig"
endif
```

## blu7t/op7-r70/drivers/input/oneplus_touchscreen/Samsung/S6SY761/Kconfig
```kconfig
#Added by Cong.Dai@Bsp.group.Tp for Samsung s6sy761 ic driver

config TOUCHPANEL_SAMSUNG_S6SY761
#	default y
	bool "TP Samsung s6sy761 IC enable or not for OP"
	---help---
	say Y to enable driver for Touchpanel using Samsung s6sy761
```

## blu7t/op7-r70/drivers/input/oneplus_touchscreen/Synaptics/Kconfig
```kconfig
source "drivers/input/oneplus_touchscreen/Synaptics/S3508/Kconfig"
source "drivers/input/oneplus_touchscreen/Synaptics/S3320/Kconfig"
source "drivers/input/oneplus_touchscreen/Synaptics/S3706/Kconfig"
source "drivers/input/oneplus_touchscreen/Synaptics/S4322/Kconfig"
source "drivers/input/oneplus_touchscreen/Synaptics/TD4310/Kconfig"
source "drivers/input/oneplus_touchscreen/Synaptics/Syna_tcm/Kconfig"
source "drivers/input/oneplus_touchscreen/Synaptics/S1302_virtal_key/Kconfig"
```

## blu7t/op7-r70/drivers/input/oneplus_touchscreen/Synaptics/S3706/Kconfig
```kconfig
#Added by Tong.han@Bsp.group.Tp for synaptics ic driver

config TOUCHPANEL_SYNAPTICS_S3706
#	default y
	bool "TP Synaptics_S3508 IC enable or not for OP"
	---help---
	say Y to enable driver for Touchpanel useing synaptics s3706
	say Y to enable driver for Touchpanel useing synaptics s3706
	
```

## blu7t/op7-r70/drivers/input/oneplus_touchscreen/Synaptics/S4322/Kconfig
```kconfig
#Added by Tong.han@Bsp.group.Tp for synaptics ic driver

config TOUCHPANEL_SYNAPTICS_S4322
#	default y
	bool "TP Synaptics_S3508 IC enable or not for OP"
	---help---
	say Y to enable driver for Touchpanel useing synaptics S3320
```

## blu7t/op7-r70/drivers/input/oneplus_touchscreen/Synaptics/Syna_tcm/Kconfig
```kconfig
#
# Synaptics TCM touchscreen driver configuration
#
config TOUCHPANEL_SYNAPTICS_TCM
	bool "Synaptics TCM touchscreen"
	default n
	help
	  Say Y here if you have a Synaptics TCM touchscreen connected
	  to your system.

	  If unsure, say N.
```

## blu7t/op7-r70/drivers/input/oneplus_touchscreen/Synaptics/TD4310/Kconfig
```kconfig
config TOUCHPANEL_SYNAPTICS_TD4310
	default n
	bool "TP Synaptics_TD4310 IC enable or not for OP"
	---help---
	say Y to enable driver for Touchpanel useing synaptics TD4310
```

## blu7t/op7-r70/drivers/nfc/nxp/ese/Kconfig
```kconfig
config NXP_ESE_SN1XX
	bool "Nxp ESE sn1xx Controller"
	---help---
	  You'll have to say Y if your computer contains an sn1xx SPI device that
	  you want to use under Linux.

	  You can say N here if you don't have any sn1xx SPI connected to your computer.

config NXP_ESE_PN8XT
	bool "Nxp ESE pn8xt Controller"
	---help---
	  You'll have to say Y if your computer contains an pn8xt SPI device that
	  you want to use under Linux.

	  You can say N here if you don't have any pn8xt SPI connected to your computer.
```

## blu7t/op7-r70/drivers/oem_debug/Kconfig
```kconfig
config OEM_FORCE_DUMP
	default y
	bool "OEM force dump function, it will enable goto the force dump"
```

## blu7t/op7-r70/drivers/oneplus/Kconfig
```kconfig
config OEM_BOOT_MODE
	bool "detect oem boot mode"
	default y
	help
          detect oem boot mode  If unsure, say y.


config WB_KERNEL_LOG
	tristate "reserve kernel log to partition driver"
	default n

source "drivers/oneplus/coretech/Kconfig"
source "drivers/oneplus/oneplus_healthinfo/Kconfig"
```

## blu7t/op7-r70/drivers/oneplus/coretech/Kconfig
```kconfig
config ADJ_CHAIN
	default n
	bool "Chain task adj for victim select"
	help
	 To chain task adj for any purpose
```

## blu7t/op7-r70/drivers/oneplus/oneplus_healthinfo/Kconfig
```kconfig
config ONEPLUS_HEALTHINFO
	default n
	bool "config oneplus healthinfo"
	help
	  define this config to init oneplus healthinfo.
```

## blu7t/op7-r70/drivers/param_read_write/Kconfig
```kconfig
config PARAM_READ_WRITE
	bool "Param partition read/write support"
	default n
	help
		if you want to read/write the param partition in kernel,
		then you must say Y here.
```

## blu7t/op7-r70/drivers/step_motor/Kconfig
```kconfig
config STEP_MOTOR
	tristate "Step motor driver for stspin220"
	help
	  This option enable support for stspin220 step motor Driver.

config DIGITAL_HALL_M1120
	tristate "digital hall m1120 Controler"
	default n
	help
	  Say Y here to enable m1120.
```

## blu7t/op7-r70/drivers/tri_state_key/Kconfig
```kconfig
config TRI_STATE_KEY
        default n
        tristate "switch Profiles by this triple key"
        help
        Say Y here if you want to enable the feature.

config HALL_TRI_STATE_KEY
        default n
        tristate "switch Profiles by this triple key"
        help
        Say Y here if you want to enable the feature.

source "drivers/tri_state_key/hall_ic/Kconfig"
source "drivers/tri_state_key/ist_hall_ic/Kconfig"
```

## blu7t/op7-r70/drivers/tri_state_key/hall_ic/Kconfig
```kconfig
config SENSOR_HALL_MXM1120
	tristate "digital hall m1120 Controler"
	default n
	help
		Say Y here to enable m1120.
```

## blu7t/op7-r70/drivers/tri_state_key/ist_hall_ic/Kconfig
```kconfig
config SENSOR_HALL_IST8801
	tristate "digital hall ist8801 Controler"
	default n
	help
		Say Y here to enable ist8801.
```

## blu7t/op7-r70/drivers/vibrator/Kconfig
```kconfig
config AW8697_HAPTIC
       tristate "Haptic driver for awinic aw8697 series"
       depends on I2C
       help
       This option enables support for aw8697 series Haptic Driver.
 comment "LED Triggers"
```

## blu7t/op7-r70/drivers/video/klapse/Kconfig
```kconfig
config KLAPSE
    bool CONFIG_KLAPSE
    default n
    help
        A simple rgb dynamic lapsing module similar to LineageOS' livedisplay
```
